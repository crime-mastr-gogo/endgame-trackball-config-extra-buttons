#include <dt-bindings/led/led.h>

&spi2 {
	compatible = "nordic,nrf-spim";
	status = "okay";
	pinctrl-0 = <&spi2_default>;
	pinctrl-1 = <&spi2_sleep>;
	pinctrl-names = "default", "sleep";

	led_strip: ws2812@0 {
		compatible = "worldsemi,ws2812-spi";
		reg = <0>;
		chain-length = <16>;
		spi-max-frequency = <4000000>;
		spi-one-frame = <0x70>;
		spi-zero-frame = <0x40>;
		spi-cpha;

		color-mapping =
			<
				LED_COLOR_ID_GREEN
				LED_COLOR_ID_RED
				LED_COLOR_ID_BLUE
			>;
	};
};
