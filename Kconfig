## Kconfig
```kconfig
rsource "vendor/adaptive-feedback/Kconfig"
config ZMK_FEEDBACK_COMMON
    bool "Bounded shared vibration driver"
    default y
    depends on GPIO
```

## boards/arm/efogtech_trackball_0/Kconfig
```kconfig
config ANKUR_RGB_PRESENT
    bool "RGB hardware fitted to this customised Endgame"
    default y
    help
      Explicit hardware selection. IO1 and IO2 are button inputs and must
      never be used for the original RGB detection probe.
```

## config/west.yml
```yaml
manifest:
  remotes:
    - name: efogdev
      url-base: https://github.com/efogdev

  projects:
    - name: zmk
      remote: efogdev
      revision: "50d5707901f3dd89f967cf4fee90735758fd9766"
      import: app/west.yml

    - name: zmk-pmw3610-driver
      remote: efogdev
      revision: "d5d2e1a6607a60ff8e8cde9cf2d33e49763ee7f6"

    - name: zmk-pointer-2s-mixer
      remote: efogdev
      revision: "8f41b5e6d971d8973873a465e678c88a36e86c8c"

    - name: zmk-axis-clamper
      remote: efogdev
      revision: "637719fcc3703b538c0f16fd127a6901f8e4175d"

    - name: zmk-report-rate-limit
      remote: efogdev
      revision: "20e074280bc6e40206c6efb647d9f5ce5c3f8ecb"

    - name: zmk-acceleration-curves
      remote: efogdev
      revision: "f598fdef3d63cd7310a6506b9d88a75abc2d0f2b"

    - name: zmk-input-processor-rotate-plane
      remote: efogdev
      revision: "86901be4463d02d2a653d2d2d708068baba42b04"

    - name: zmk-runtime-config
      remote: efogdev
      revision: "55fabb61e9466df5e8c8b6d933da02a154aa8b56"

    - name: zmk-bistable-behavior
      remote: efogdev
      revision: "652ae06696cf5ed5b5d3c82c146d3edc6d23fa98"

    - name: zmk-esb-endpoint
      remote: efogdev
      revision: "89b695a9aca6dc5a7daf4488140ef46e19fc266c"
      submodules: true

    # Retained as a build-time Kconfig dependency of the pinned ESB module.
    # CONFIG_ZMK_ESB_ENDPOINT_SHELL_RELAY remains disabled.
    - name: zmk-shell-relay-core
      remote: efogdev
      revision: "b4a7eb0b7668d0ff08ecba9a2cb468fb3482df22"

  self:
    path: config
```

## dts/bindings/behaviors/ankur,control.yaml
```yaml
description: Endgame custom controls with protected hold actions
compatible: "ankur,control"
include: one_param.yaml
```

## dts/bindings/behaviors/zmk,behavior-device-action-feedback.yaml
```yaml
description: Trigger adaptive feedback for a device-management action

compatible: "zmk,behavior-device-action-feedback"

include: one_param.yaml
```

## dts/bindings/behaviors/zmk,behavior-drag-lock.yaml
```yaml
description: Toggle and retain the left mouse button state

compatible: "zmk,behavior-drag-lock"

include: zero_param.yaml
```

## dts/bindings/behaviors/zmk,behavior-endgame-control.yaml
```yaml
description: Report current Endgame settings or toggle persistent feedback outputs

compatible: "zmk,behavior-endgame-control"

include: one_param.yaml
```

## dts/bindings/behaviors/zmk,behavior-scroll-mode-toggle.yaml
```yaml
description: Toggle between high-resolution and standard twist scrolling

compatible: "zmk,behavior-scroll-mode-toggle"

include: zero_param.yaml
```

## dts/bindings/behaviors/zmk,behavior-sensitivity-feedback.yaml
```yaml
description: Adjust pointer or twist sensitivity with adaptive feedback

compatible: "zmk,behavior-sensitivity-feedback"

include: zero_param.yaml

properties:
  scroll:
    type: boolean
    description: Adjust twist-scroll sensitivity instead of pointer sensitivity

  increase:
    type: boolean
    description: Increase sensitivity instead of decreasing it
```

## dts/bindings/input_processors/ankur,pointer-modes.yaml
```yaml
description: Select the proven Endgame pointer pipeline without extra keymap layers
compatible: "ankur,pointer-modes"
include: ip_zero_param.yaml
properties:
  pipeline-devices:
    type: phandles
    required: true
```

## dts/bindings/input_processors/ankur,scroll-mode.yaml
```yaml
description: Quantize standard scrolling while conserving accumulated displacement
compatible: "ankur,scroll-mode"
include: ip_zero_param.yaml
```

## dts/bindings/zmk,feedback-common.yaml
```yaml
description: Shared feedback GPIO singleton

compatible: "zmk,feedback-common"

properties:
  feedback-gpios:
    type: phandle-array
  feedback-extra-gpios:
    type: phandle-array
```
